## u-boot-2017.05-rc2/arch/arm/mach-s5pc210/Kconfig
```kconfig
if ARCH_S5PC210

choice
	prompt "S5PC210 board select"
	optional

config TARGET_S5P_GONI
	bool "S5P Goni board"
	select OF_CONTROL

config TARGET_SMDKC210
	bool "Support smdk210 board"
	select OF_CONTROL

endchoice

config SYS_SOC
	default "s5pc210"

source "board/samsung/goni/Kconfig"
source "board/samsung/smdkc210/Kconfig"

endif
```

## u-boot-2017.05-rc2/board/samsung/smdkc210/Kconfig
```kconfig
if TARGET_SMDKC100

config SYS_BOARD
	default "smdkc210"

config SYS_VENDOR
	default "samsung"

config SYS_SOC
	default "s5pc210"

config SYS_CONFIG_NAME
	default "smdkc210"

endif
```

## u-boot-2017.05-rc2/configs/smdkc210_defconfig
```kconfig
CONFIG_ARM=y
CONFIG_ARCH_S5PC210=y
CONFIG_TARGET_SMDKC210=y
CONFIG_IDENT_STRING=" for SMDKC210"
CONFIG_DEFAULT_DEVICE_TREE="s5pc1xx-smdkc210"
CONFIG_BOOTDELAY=3
CONFIG_HUSH_PARSER=y
CONFIG_SYS_PROMPT="SMDKC210 # "
# CONFIG_CMD_IMLS is not set
# CONFIG_CMD_FLASH is not set
# CONFIG_CMD_SETEXPR is not set
CONFIG_CMD_CACHE=y
CONFIG_CMD_FAT=y
# CONFIG_MMC is not set
```
